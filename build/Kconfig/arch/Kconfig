## build/Kconfig/arch/Kconfig
```kconfig
# Load Zephyr Arch Kconfig descriptions.
osource "/home/athul/Workspace/Zephyr/zephyr/arch/tricore/Kconfig"
osource "/home/athul/Workspace/Zephyr/zephyr/arch/hexagon/Kconfig"
osource "/home/athul/Workspace/Zephyr/zephyr/arch/rx/Kconfig"
osource "/home/athul/Workspace/Zephyr/zephyr/arch/x86/Kconfig"
osource "/home/athul/Workspace/Zephyr/zephyr/arch/xtensa/Kconfig"
osource "/home/athul/Workspace/Zephyr/zephyr/arch/sparc/Kconfig"
osource "/home/athul/Workspace/Zephyr/zephyr/arch/riscv/Kconfig"
osource "/home/athul/Workspace/Zephyr/zephyr/arch/posix/Kconfig"
osource "/home/athul/Workspace/Zephyr/zephyr/arch/openrisc/Kconfig"
osource "/home/athul/Workspace/Zephyr/zephyr/arch/mips/Kconfig"
osource "/home/athul/Workspace/Zephyr/zephyr/arch/arm64/Kconfig"
osource "/home/athul/Workspace/Zephyr/zephyr/arch/arm/Kconfig"
osource "/home/athul/Workspace/Zephyr/zephyr/arch/arc/Kconfig"
```

## build/Kconfig/boards/Kconfig.defconfig
```kconfig
# Load Zephyr board defconfig descriptions.
osource "/home/athul/Workspace/Zephyr/zephyr/boards/arm/mps2/Kconfig.defconfig"
```

## build/Kconfig/boards/Kconfig.mps2
```kconfig
# Load board Kconfig descriptions.
osource "/home/athul/Workspace/Zephyr/zephyr/boards/arm/mps2/Kconfig.mps2"
```

## build/Kconfig/soc/Kconfig
```kconfig
# Load Zephyr SoC Kconfig descriptions.
osource "/home/athul/Workspace/Zephyr/zephyr/soc/xlnx/zynqmp/Kconfig"
osource "/home/athul/Workspace/Zephyr/zephyr/soc/xlnx/zynq7000/Kconfig"
osource "/home/athul/Workspace/Zephyr/zephyr/soc/xlnx/versalnet/Kconfig"
osource "/home/athul/Workspace/Zephyr/zephyr/soc/xlnx/versal2/Kconfig"
osource "/home/athul/Workspace/Zephyr/zephyr/soc/xlnx/versal/Kconfig"
osource "/home/athul/Workspace/Zephyr/zephyr/soc/xen/Kconfig"
osource "/home/athul/Workspace/Zephyr/zephyr/soc/wch/ch32v/Kconfig"
osource "/home/athul/Workspace/Zephyr/zephyr/soc/ti/tiva_c/Kconfig"
osource "/home/athul/Workspace/Zephyr/zephyr/soc/ti/simplelink/Kconfig"
osource "/home/athul/Workspace/Zephyr/zephyr/soc/ti/mspm/Kconfig"
osource "/home/athul/Workspace/Zephyr/zephyr/soc/ti/lm3s6965/Kconfig"
osource "/home/athul/Workspace/Zephyr/zephyr/soc/ti/k3/Kconfig"
osource "/home/athul/Workspace/Zephyr/zephyr/soc/ti/am13/Kconfig"
osource "/home/athul/Workspace/Zephyr/zephyr/soc/telink/tlsr/Kconfig"
osource "/home/athul/Workspace/Zephyr/zephyr/soc/syna/sr100/Kconfig"
osource "/home/athul/Workspace/Zephyr/zephyr/soc/starfive/jh71xx/Kconfig"
osource "/home/athul/Workspace/Zephyr/zephyr/soc/st/stm32/Kconfig"
osource "/home/athul/Workspace/Zephyr/zephyr/soc/snps/qemu_arc/Kconfig"
osource "/home/athul/Workspace/Zephyr/zephyr/soc/snps/nsim/arc_v/Kconfig"
osource "/home/athul/Workspace/Zephyr/zephyr/soc/snps/nsim/arc_classic/Kconfig"
osource "/home/athul/Workspace/Zephyr/zephyr/soc/snps/hsdk4xd/Kconfig"
osource "/home/athul/Workspace/Zephyr/zephyr/soc/snps/hsdk/Kconfig"
osource "/home/athul/Workspace/Zephyr/zephyr/soc/snps/emsk/Kconfig"
osource "/home/athul/Workspace/Zephyr/zephyr/soc/snps/emsdp/Kconfig"
osource "/home/athul/Workspace/Zephyr/zephyr/soc/snps/arc_iot/Kconfig"
osource "/home/athul/Workspace/Zephyr/zephyr/soc/silabs/Kconfig"
osource "/home/athul/Workspace/Zephyr/zephyr/soc/sifli/sf32/Kconfig"
osource "/home/athul/Workspace/Zephyr/zephyr/soc/sifive/sifive_freedom/Kconfig"
osource "/home/athul/Workspace/Zephyr/zephyr/soc/shakti/Kconfig"
osource "/home/athul/Workspace/Zephyr/zephyr/soc/sensry/Kconfig"
osource "/home/athul/Workspace/Zephyr/zephyr/soc/rockchip/Kconfig"
osource "/home/athul/Workspace/Zephyr/zephyr/soc/renode/riscv_virtual/Kconfig"
osource "/home/athul/Workspace/Zephyr/zephyr/soc/renode/cortex_r8_virtual/Kconfig"
osource "/home/athul/Workspace/Zephyr/zephyr/soc/renesas/smartbond/Kconfig"
osource "/home/athul/Workspace/Zephyr/zephyr/soc/renesas/rz/Kconfig"
osource "/home/athul/Workspace/Zephyr/zephyr/soc/renesas/rx/Kconfig"
osource "/home/athul/Workspace/Zephyr/zephyr/soc/renesas/rcar/Kconfig"
osource "/home/athul/Workspace/Zephyr/zephyr/soc/renesas/ra/Kconfig"
osource "/home/athul/Workspace/Zephyr/zephyr/soc/realtek/fingerprint/Kconfig"
osource "/home/athul/Workspace/Zephyr/zephyr/soc/realtek/ec/Kconfig"
osource "/home/athul/Workspace/Zephyr/zephyr/soc/realtek/bee/Kconfig"
osource "/home/athul/Workspace/Zephyr/zephyr/soc/realtek/ameba/Kconfig"
osource "/home/athul/Workspace/Zephyr/zephyr/soc/raspberrypi/rpi_pico/Kconfig"
osource "/home/athul/Workspace/Zephyr/zephyr/soc/quicklogic/eos_s3/Kconfig"
osource "/home/athul/Workspace/Zephyr/zephyr/soc/qemu/virt_riscv/Kconfig"
osource "/home/athul/Workspace/Zephyr/zephyr/soc/qemu/tricore/Kconfig"
osource "/home/athul/Workspace/Zephyr/zephyr/soc/qemu/or1k/Kconfig"
osource "/home/athul/Workspace/Zephyr/zephyr/soc/qemu/malta/Kconfig"
osource "/home/athul/Workspace/Zephyr/zephyr/soc/qemu/hexagon/Kconfig"
osource "/home/athul/Workspace/Zephyr/zephyr/soc/openisa/rv32m1/Kconfig"
osource "/home/athul/Workspace/Zephyr/zephyr/soc/openhwgroup/cva6/Kconfig"
osource "/home/athul/Workspace/Zephyr/zephyr/soc/oct/osd32mp15x/Kconfig"
osource "/home/athul/Workspace/Zephyr/zephyr/soc/nxp/s32/Kconfig"
osource "/home/athul/Workspace/Zephyr/zephyr/soc/nxp/rw/Kconfig"
osource "/home/athul/Workspace/Zephyr/zephyr/soc/nxp/mcx/Kconfig"
osource "/home/athul/Workspace/Zephyr/zephyr/soc/nxp/lpc/Kconfig"
osource "/home/athul/Workspace/Zephyr/zephyr/soc/nxp/layerscape/Kconfig"
osource "/home/athul/Workspace/Zephyr/zephyr/soc/nxp/kinetis/Kconfig"
osource "/home/athul/Workspace/Zephyr/zephyr/soc/nxp/imxrt/Kconfig"
osource "/home/athul/Workspace/Zephyr/zephyr/soc/nxp/imx/Kconfig"
osource "/home/athul/Workspace/Zephyr/zephyr/soc/nuvoton/numicro/Kconfig"
osource "/home/athul/Workspace/Zephyr/zephyr/soc/nuvoton/numaker/Kconfig"
osource "/home/athul/Workspace/Zephyr/zephyr/soc/nuvoton/npcx/Kconfig"
osource "/home/athul/Workspace/Zephyr/zephyr/soc/nuvoton/npcm/Kconfig"
osource "/home/athul/Workspace/Zephyr/zephyr/soc/nordic/Kconfig"
osource "/home/athul/Workspace/Zephyr/zephyr/soc/neorv32/Kconfig"
osource "/home/athul/Workspace/Zephyr/zephyr/soc/native/inf_clock/Kconfig"
osource "/home/athul/Workspace/Zephyr/zephyr/soc/microchip/smartfusion2/Kconfig"
osource "/home/athul/Workspace/Zephyr/zephyr/soc/microchip/sam/sama7/Kconfig"
osource "/home/athul/Workspace/Zephyr/zephyr/soc/microchip/sam/sama5/Kconfig"
osource "/home/athul/Workspace/Zephyr/zephyr/soc/microchip/sam/sam_d5x_e5x/Kconfig"
osource "/home/athul/Workspace/Zephyr/zephyr/soc/microchip/pic64/Kconfig"
osource "/home/athul/Workspace/Zephyr/zephyr/soc/microchip/pic32c/pic32cz_ca/Kconfig"
osource "/home/athul/Workspace/Zephyr/zephyr/soc/microchip/pic32c/pic32cx_sg/Kconfig"
osource "/home/athul/Workspace/Zephyr/zephyr/soc/microchip/pic32c/pic32cm_sg_gc/Kconfig"
osource "/home/athul/Workspace/Zephyr/zephyr/soc/microchip/pic32c/pic32cm_pl/Kconfig"
osource "/home/athul/Workspace/Zephyr/zephyr/soc/microchip/pic32c/pic32cm_jh/Kconfig"
osource "/home/athul/Workspace/Zephyr/zephyr/soc/microchip/pic32c/pic32ck_sg_gc/Kconfig"
osource "/home/athul/Workspace/Zephyr/zephyr/soc/microchip/miv/Kconfig"
osource "/home/athul/Workspace/Zephyr/zephyr/soc/microchip/mec/Kconfig"
osource "/home/athul/Workspace/Zephyr/zephyr/soc/mediatek/mt8xxx/Kconfig"
osource "/home/athul/Workspace/Zephyr/zephyr/soc/lowrisc/opentitan/Kconfig"
osource "/home/athul/Workspace/Zephyr/zephyr/soc/litex/Kconfig"
osource "/home/athul/Workspace/Zephyr/zephyr/soc/ite/ec/Kconfig"
osource "/home/athul/Workspace/Zephyr/zephyr/soc/intel/wildcat_lake/Kconfig"
osource "/home/athul/Workspace/Zephyr/zephyr/soc/intel/raptor_lake/Kconfig"
osource "/home/athul/Workspace/Zephyr/zephyr/soc/intel/panther_lake/Kconfig"
osource "/home/athul/Workspace/Zephyr/zephyr/soc/intel/nova_lake/Kconfig"
osource "/home/athul/Workspace/Zephyr/zephyr/soc/intel/lakemont/Kconfig"
osource "/home/athul/Workspace/Zephyr/zephyr/soc/intel/intel_socfpga_std/Kconfig"
osource "/home/athul/Workspace/Zephyr/zephyr/soc/intel/intel_socfpga/Kconfig"
osource "/home/athul/Workspace/Zephyr/zephyr/soc/intel/intel_niosv/Kconfig"
osource "/home/athul/Workspace/Zephyr/zephyr/soc/intel/intel_ish/Kconfig"
osource "/home/athul/Workspace/Zephyr/zephyr/soc/intel/intel_adsp/Kconfig"
osource "/home/athul/Workspace/Zephyr/zephyr/soc/intel/elkhart_lake/Kconfig"
osource "/home/athul/Workspace/Zephyr/zephyr/soc/intel/atom/Kconfig"
osource "/home/athul/Workspace/Zephyr/zephyr/soc/intel/apollo_lake/Kconfig"
osource "/home/athul/Workspace/Zephyr/zephyr/soc/intel/alder_lake/Kconfig"
osource "/home/athul/Workspace/Zephyr/zephyr/soc/infineon/psoc4/Kconfig"
osource "/home/athul/Workspace/Zephyr/zephyr/soc/infineon/edge/Kconfig"
osource "/home/athul/Workspace/Zephyr/zephyr/soc/infineon/cat3/Kconfig"
osource "/home/athul/Workspace/Zephyr/zephyr/soc/infineon/cat1c/Kconfig"
osource "/home/athul/Workspace/Zephyr/zephyr/soc/infineon/cat1b/Kconfig"
osource "/home/athul/Workspace/Zephyr/zephyr/soc/infineon/cat1a/Kconfig"
osource "/home/athul/Workspace/Zephyr/zephyr/soc/gd/gd32/Kconfig"
osource "/home/athul/Workspace/Zephyr/zephyr/soc/gaisler/leon3/Kconfig"
osource "/home/athul/Workspace/Zephyr/zephyr/soc/gaisler/gr716a/Kconfig"
osource "/home/athul/Workspace/Zephyr/zephyr/soc/focaltech/Kconfig"
osource "/home/athul/Workspace/Zephyr/zephyr/soc/espressif/Kconfig"
osource "/home/athul/Workspace/Zephyr/zephyr/soc/ene/kb1200/Kconfig"
osource "/home/athul/Workspace/Zephyr/zephyr/soc/ene/kb106x/Kconfig"
osource "/home/athul/Workspace/Zephyr/zephyr/soc/elan/em32f967/Kconfig"
osource "/home/athul/Workspace/Zephyr/zephyr/soc/egis/Kconfig"
osource "/home/athul/Workspace/Zephyr/zephyr/soc/efinix/sapphire/Kconfig"
osource "/home/athul/Workspace/Zephyr/zephyr/soc/cdns/xtensa_sample_controller/Kconfig"
osource "/home/athul/Workspace/Zephyr/zephyr/soc/cdns/swerv/Kconfig"
osource "/home/athul/Workspace/Zephyr/zephyr/soc/cdns/sample_controller32/Kconfig"
osource "/home/athul/Workspace/Zephyr/zephyr/soc/cdns/dc233c/Kconfig"
osource "/home/athul/Workspace/Zephyr/zephyr/soc/cdac/Kconfig"
osource "/home/athul/Workspace/Zephyr/zephyr/soc/brcm/bcmvk/Kconfig"
osource "/home/athul/Workspace/Zephyr/zephyr/soc/brcm/bcm2712/Kconfig"
osource "/home/athul/Workspace/Zephyr/zephyr/soc/brcm/bcm2711/Kconfig"
osource "/home/athul/Workspace/Zephyr/zephyr/soc/brcm/bcm2710/Kconfig"
osource "/home/athul/Workspace/Zephyr/zephyr/soc/blackberry/qnxhv_vm/Kconfig"
osource "/home/athul/Workspace/Zephyr/zephyr/soc/bflb/Kconfig"
osource "/home/athul/Workspace/Zephyr/zephyr/soc/atmel/sam0/Kconfig"
osource "/home/athul/Workspace/Zephyr/zephyr/soc/atmel/sam/Kconfig"
osource "/home/athul/Workspace/Zephyr/zephyr/soc/aspeed/Kconfig"
osource "/home/athul/Workspace/Zephyr/zephyr/soc/arm/Kconfig"
osource "/home/athul/Workspace/Zephyr/zephyr/soc/antmicro/myra/Kconfig"
osource "/home/athul/Workspace/Zephyr/zephyr/soc/andestech/Kconfig"
osource "/home/athul/Workspace/Zephyr/zephyr/soc/amd/acp_7_x/Kconfig"
osource "/home/athul/Workspace/Zephyr/zephyr/soc/amd/acp_7_0/Kconfig"
osource "/home/athul/Workspace/Zephyr/zephyr/soc/amd/acp_6_0/Kconfig"
osource "/home/athul/Workspace/Zephyr/zephyr/soc/ambiq/Kconfig"
osource "/home/athul/Workspace/Zephyr/zephyr/soc/allwinner/sun8i_h3/Kconfig"
osource "/home/athul/Workspace/Zephyr/zephyr/soc/allwinner/sun50i_h618/Kconfig"
osource "/home/athul/Workspace/Zephyr/zephyr/soc/alif/ensemble/Kconfig"
osource "/home/athul/Workspace/Zephyr/zephyr/soc/alif/balletto/Kconfig"
osource "/home/athul/Workspace/Zephyr/zephyr/soc/aesc/Kconfig"
osource "/home/athul/Workspace/Zephyr/zephyr/soc/adi/max32/Kconfig"
```

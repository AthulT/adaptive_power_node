## CMakeLists.txt
```
cmake_minimum_required(VERSION 3.20.0)

find_package(Zephyr REQUIRED HINTS $ENV{ZEPHYR_BASE})
project(adaptive_power_node)

target_sources(app PRIVATE 
    src/main.c
    src/ble_power_svc.c
)
```

## prj.conf
```kconfig
# Core Kernel Configuration
CONFIG_MAIN_STACK_SIZE=2048
CONFIG_SYSTEM_WORKQUEUE_STACK_SIZE=2048

# Console Setup
CONFIG_SERIAL=y
CONFIG_CONSOLE=y
CONFIG_UART_CONSOLE=y
CONFIG_PRINTK=y
CONFIG_LOG=y

# Bluetooth Host
CONFIG_BT=y
CONFIG_BT_PERIPHERAL=y
CONFIG_BT_DEVICE_NAME="EFR32_M33_QEMU"

# HCI UART Transport Driver
CONFIG_BT_H4=y

# Require UART Driver with Interrupt Support
CONFIG_UART_INTERRUPT_DRIVEN=y
```

## app.overlay
```dts
&uart1 {
    status = "okay";
    current-speed = <115200>;
    bt_hci_uart: bt_hci_uart {
        compatible = "zephyr,bt-hci-uart";
        status = "okay";
    };
};

/ {
    chosen {
        zephyr,bt-hci = &bt_hci_uart;
    };
};
```

## src/main.c
```c
#include <zephyr/kernel.h>
#include <zephyr/sys/printk.h>
#include "ble_power_svc.h"

int main(void) {
    uint16_t packet_seq = 0;

    int err = ble_power_svc_init();
    if (err) {
        printk("Failed to initialize BLE Power Service (err %d)\n", err);
        return err;
    }

    while (1) {
        k_msleep(500);
        packet_seq++;
        
	ble_power_svc_notify_telemetry(packet_seq);
	ble_power_svc_readvertise_if_idle();
}
    return 0;
}
```

## src/ble_power_svc.c
```c
#include <stddef.h>

#include <stdint.h>

#include <sys/types.h>

#include <zephyr/kernel.h>

#include <zephyr/sys/printk.h>

#include <zephyr/sys/util.h>

#include <zephyr/bluetooth/bluetooth.h>

#include <zephyr/bluetooth/conn.h>

#include <zephyr/bluetooth/gatt.h>

#include <zephyr/bluetooth/hci.h>

#include <zephyr/bluetooth/uuid.h>
#include "ble_power_svc.h"

#define LINK_TIMEOUT_MS 3000

static int8_t current_tx_power = 0;
static struct k_timer watchdog_timer;

#define BT_UUID_POWER_SERVICE_VAL BT_UUID_128_ENCODE(0x12345678, 0x1234, 0x5678, 0x1234, 0x56789abcdef0)
#define BT_UUID_POWER_CHAR_VAL    BT_UUID_128_ENCODE(0x12345678, 0x1234, 0x5678, 0x1234, 0x56789abcdef1)

static struct bt_uuid_128 power_service_uuid = BT_UUID_INIT_128(BT_UUID_POWER_SERVICE_VAL);
static struct bt_uuid_128 power_char_uuid = BT_UUID_INIT_128(BT_UUID_POWER_CHAR_VAL);

/* Watchdog fallback: reset power to MAX if host fails to check in */
static void watchdog_expiry_fn(struct k_timer *timer) {
    printk("[WATCHDOG] Link timeout! Forcing TX power to MAX (%d dBm)\n", MAX_TX_POWER);
    current_tx_power = MAX_TX_POWER;
}

/* GATT Callback when Host sends a new TX power command */
static ssize_t write_power_cmd(struct bt_conn *conn, const struct bt_gatt_attr *attr,
                               const void *buf, uint16_t len, uint16_t offset, uint8_t flags) {
    if (len < 1) return BT_GATT_ERR(BT_ATT_ERR_INVALID_ATTRIBUTE_LEN);
    
    int8_t new_power = ((int8_t *)buf)[0];
    if (new_power >= MIN_TX_POWER && new_power <= MAX_TX_POWER) {
        current_tx_power = new_power;
        printk("[GATT WRITE] PA Output Updated -> TX Power: %d dBm\n", current_tx_power);
        k_timer_start(&watchdog_timer, K_MSEC(LINK_TIMEOUT_MS), K_NO_WAIT);
    }
    return len;
}

BT_GATT_SERVICE_DEFINE(power_svc,
    BT_GATT_PRIMARY_SERVICE(&power_service_uuid),
    BT_GATT_CHARACTERISTIC(&power_char_uuid.uuid, 
                           BT_GATT_CHRC_NOTIFY | BT_GATT_CHRC_WRITE,
                           BT_GATT_PERM_WRITE, NULL, write_power_cmd, NULL),
    BT_GATT_CCC(NULL, BT_GATT_PERM_READ | BT_GATT_PERM_WRITE),
);

static const struct bt_data ad[] = {
    BT_DATA_BYTES(BT_DATA_FLAGS, (BT_LE_AD_GENERAL | BT_LE_AD_NO_BREDR)),
    BT_DATA(BT_DATA_NAME_COMPLETE, CONFIG_BT_DEVICE_NAME, sizeof(CONFIG_BT_DEVICE_NAME)-1),
};

int ble_power_svc_init(void) {
    int err = bt_enable(NULL);
    if (err) {
        printk("Bluetooth init failed (err %d)\n", err);
        return err;
    }

    k_timer_init(&watchdog_timer, watchdog_expiry_fn, NULL);
    k_timer_start(&watchdog_timer, K_MSEC(LINK_TIMEOUT_MS), K_NO_WAIT);

    err = bt_le_adv_start(BT_LE_ADV_CONN_FAST_1, ad, ARRAY_SIZE(ad), NULL, 0);
    if (err) {
        printk("Advertising failed to start (err %d)\n", err);
        return err;
    }

    printk("Zephyr Cortex-M33 QEMU Node Advertising...\n");
    return 0;
}

int ble_power_svc_notify_telemetry(uint16_t seq) {
    uint8_t payload[3] = { 
        (seq >> 8) & 0xFF, 
        seq & 0xFF, 
        (uint8_t)current_tx_power 
    };
    return bt_gatt_notify(NULL, &power_svc.attrs[1], payload, sizeof(payload));
}

int8_t ble_power_svc_get_tx_power(void) {
    return current_tx_power;
}

static bool peer_connected;

static void connected_cb(struct bt_conn *conn, uint8_t err)
{
    if (err) {
        printk("[BLE] Connection failed (err 0x%02x)\n", err);
        return;
    }
    peer_connected = true;
    printk("[BLE] Connected\n");
}

static void disconnected_cb(struct bt_conn *conn, uint8_t reason)
{
    peer_connected = false;
    printk("[BLE] Disconnected (reason 0x%02x)\n", reason);
}

BT_CONN_CB_DEFINE(conn_callbacks) = {
    .connected = connected_cb,
    .disconnected = disconnected_cb,
};

/* btvirt only emits an advertising report when advertising is enabled,
 * so re-enable periodically or BlueZ never sees us again after discovery. */
void ble_power_svc_readvertise_if_idle(void)
{
    if (peer_connected) {
        return;
    }
    bt_le_adv_stop();
    int err = bt_le_adv_start(BT_LE_ADV_CONN_FAST_1, ad, ARRAY_SIZE(ad), NULL, 0);
    if (err) {
        printk("Re-advertise failed (err %d)\n", err);
    }
}
```

## src/ble_power_svc.h
```c
#ifndef BLE_POWER_SVC_H_
#define BLE_POWER_SVC_H_

#include <stdint.h>

#define MAX_TX_POWER 8
#define MIN_TX_POWER -26

/**
 * @brief Initialize the Bluetooth stack, GATT service, and watchdog timer.
 * @return 0 on success, negative error code on failure.
 */
int ble_power_svc_init(void);

/**
 * @brief Sends a BLE GATT notification containing sequence number and current TX power.
 * @param seq Packet sequence number.
 * @return 0 on success, negative error code on failure.
 */
int ble_power_svc_notify_telemetry(uint16_t seq);

/**
 * @brief Get the current configured TX power level.
 * @return Current TX power in dBm.
 */
int8_t ble_power_svc_get_tx_power(void);
void ble_power_svc_readvertise_if_idle(void);
#endif /* BLE_POWER_SVC_H_ */
```
